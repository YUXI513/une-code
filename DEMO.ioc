# file: DEMO.ioc
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Mcu.Family=STM32G4
Mcu.Name=STM32G474R(B-C-E)Tx
Mcu.Package=LQFP64
NVIC.PriorityGroup=NVIC_PRIORITYGROUP_4
PA13.Mode=Serial_Wire
PA13.Signal=SYS_JTMS-SWDIO
PA14.Mode=Serial_Wire
PA14.Signal=SYS_JTCK-SWCLK
PA5.GPIO_Label=LED
PA5.Signal=GPIO_Output
PF0-OSC_IN.Mode=HSE-External-Oscillator
PF0-OSC_IN.Signal=RCC_OSC_IN
PF1-OSC_OUT.Mode=HSE-External-Oscillator
PF1-OSC_OUT.Signal=RCC_OSC_OUT
ProjectManager.HeapSize=0x200
ProjectManager.StackSize=0x400
ProjectManager.TargetToolchain=CMake
RCC.AHBFreq_Value=168000000
RCC.APB1Freq_Value=168000000
RCC.APB1TimFreq_Value=168000000
RCC.APB2Freq_Value=168000000
RCC.APB2TimFreq_Value=168000000
RCC.CortexFreq_Value=168000000
RCC.EXTERNAL_CLOCK_VALUE=12288000
RCC.HCLKFreq_Value=168000000
RCC.HSE_VALUE=8000000
RCC.HSI48_VALUE=48000000
RCC.HSI_VALUE=16000000
RCC.LSE_VALUE=32768
RCC.PLLM=RCC_PLLM_DIV2
RCC.PLLN=84
RCC.PLLSourceVirtual=RCC_PLLSOURCE_HSE
RCC.SYSCLKFreq_VALUE=168000000
RCC.SYSCLKSource=RCC_SYSCLKSOURCE_PLLCLK
RCC.USBFreq_Value=168000000
RCC.VCOOutputFreq_Value=336000000
VP_SYS_VS_DBSignals.Mode=DisableDeadBatterySignals
board=custom

// file: Core/Src/main.c
/* USER CODE BEGIN Header */
/**
  ******************************************************************************
  * @file           : main.c
  * @brief          : Main program body
  ******************************************************************************
  * @attention
  *
  * Copyright (c) 2026 STMicroelectronics.
  * All rights reserved.
  *
  * This software is licensed under terms that can be found in the LICENSE file
  * in the root directory of this software component.
  * If no LICENSE file comes with this software, it is provided AS-IS.
  *
  ******************************************************************************
  */
/* USER CODE END Header */
#include "main.h"

/* USER CODE BEGIN Includes */
#include "oled.h"
#include "buck_pwm.h"
#include "buck_adc.h"
#include "buck_display_filter.h"
#include "buck_voltage_display.h"
#include "buck_control.h"
#include <math.h>
#include <stdio.h>
/* USER CODE END Includes */

/* USER CODE BEGIN PD */
/* Safe fallback for builds outside this CMake configuration. */
#ifndef ADC_ONLY_TEST
#define ADC_ONLY_TEST 1
#endif
/* USER CODE END PD */

/* USER CODE BEGIN PV */
volatile uint32_t adc_schedule_missed;
volatile HAL_StatusTypeDef adc_init_status;
/* Display-only values; buck_input/output_voltage remain unsmoothed. */
volatile float buck_input_voltage_display = NAN;
volatile float buck_output_voltage_display = NAN;
static BuckDisplayFilter input_display_filter;
static BuckDisplayFilter output_display_filter;
static BuckDisplayFilter input_current_display_filter;
static BuckDisplayFilter output_current_display_filter;
static BuckDisplayDigits input_display_digits;
static BuckDisplayDigits output_display_digits;
/* USER CODE END PV */

void SystemClock_Config(void);
static void MX_GPIO_Init(void);

/* USER CODE BEGIN 0 */
#if ADC_ONLY_TEST || BUCK_CONTROL_POWER_STAGE
static void App_HoldPWMInactive(void)
{
    GPIO_InitTypeDef gpio = {0};
    /* No TIM1 initialization, alternate function, counter, MOE or start.
     * Load the output latch LOW before selecting GPIO output mode. */
    __HAL_RCC_GPIOA_CLK_ENABLE();
    __HAL_RCC_GPIOB_CLK_ENABLE();
    HAL_GPIO_WritePin(GPIOA, GPIO_PIN_10, GPIO_PIN_RESET);
    HAL_GPIO_WritePin(GPIOB, GPIO_PIN_13 | GPIO_PIN_15, GPIO_PIN_RESET);
    gpio.Mode = GPIO_MODE_OUTPUT_PP;
    gpio.Pull = GPIO_NOPULL;
    gpio.Speed = GPIO_SPEED_FREQ_LOW;
    gpio.Pin = GPIO_PIN_10;
    HAL_GPIO_Init(GPIOA, &gpio);
    /* PB15 is the new low-side output; retired PB13 must not toggle while
     * the internal reference buffer supplies ADC VREF+. */
    gpio.Pin = GPIO_PIN_13 | GPIO_PIN_15;
    HAL_GPIO_Init(GPIOB, &gpio);
}
#endif

static void App_SetVoltageLine(uint8_t row, const char *label, float voltage, uint32_t estimate)
{
    char line[22];
    BuckVoltageDisplay_Format(line, sizeof(line), label, voltage, estimate);
    OLED_SetTextLine(row, line);
}

static void App_SetMeasurementLine(uint8_t row, const char *label, float value,
                                   const char *unit, uint32_t estimate)
{
    char line[48];
    if (isfinite(value))
    {
        /* newlib-nano is linked without float printf support. Convert to
         * signed hundredths and format with integer specifiers instead. */
        if (fabsf(value) <= 20000000.0f)
        {
            int32_t hundredths = (int32_t)(value * 100.0f
                                  + (value >= 0.0f ? 0.5f : -0.5f));
            uint32_t magnitude = hundredths < 0
                ? (uint32_t)(-hundredths) : (uint32_t)hundredths;
            (void)snprintf(line, sizeof(line), "%s：%s%s%lu.%02lu%s", label,
                           estimate ? "~" : "", hundredths < 0 ? "-" : "",
                           (unsigned long)(magnitude / 100U),
                           (unsigned long)(magnitude % 100U), unit);
        }
        else
        {
            (void)snprintf(line, sizeof(line), "%s：%sOVR%s", label,
                           estimate ? "~" : "", unit);
        }
    }
    else
        (void)snprintf(line, sizeof(line), "%s：---%s", label, unit);
    OLED_SetTextLine(row, line);
}

static void App_UpdateVoltageMonitor(void)
{
    float input = BuckADC_GetInputVoltageForDisplay();
    float output = BuckADC_GetOutputVoltageForDisplay();
    uint32_t input_estimate = (adc_input_error_code & BUCK_ADC_ERR_REFERENCE) != 0U;
    uint32_t output_estimate = (adc_output_error_code & BUCK_ADC_ERR_REFERENCE) != 0U;
    uint32_t input_source = input_estimate | ((adc_input_error_code & BUCK_ADC_ERR_NEGATIVE) ? 2U : 0U);
    uint32_t output_source = output_estimate | ((adc_output_error_code & BUCK_ADC_ERR_NEGATIVE) ? 2U : 0U);
    uint32_t now = HAL_GetTick();
    /* A sign anomaly must not be hidden by the old positive digit history. */
    float filtered_input = BuckDisplayFilter_Update(&input_display_filter, input, now, input_source);
    float filtered_output = BuckDisplayFilter_Update(&output_display_filter, output, now, output_source);
    float input_current = BuckADC_GetInputCurrentForDisplay();
    float output_current = BuckADC_GetOutputCurrentForDisplay();
    uint32_t current_source = (adc_error_code & BUCK_ADC_ERR_REFERENCE) != 0U;
    (void)BuckDisplayFilter_UpdateWithTau(&input_current_display_filter, input_current,
                                          now, current_source,
                                          BUCK_CURRENT_DISPLAY_FILTER_TAU_MS);
    (void)BuckDisplayFilter_UpdateWithTau(&output_current_display_filter, output_current,
                                          now, current_source,
                                          BUCK_CURRENT_DISPLAY_FILTER_TAU_MS);
    /* Invalidate digit history immediately, even between OLED refreshes. */
    if (!isfinite(filtered_input))
        buck_input_voltage_display = BuckDisplayDigits_Update(&input_display_digits, NAN, now, input_source);
    if (!isfinite(filtered_output))
        buck_output_voltage_display = BuckDisplayDigits_Update(&output_display_digits, NAN, now, output_source);
}

static void App_UpdateVoltageDisplay(void)
{
    char line[22];
    /* Recheck current ADC validity before showing a stored filter value. */
    float input = BuckADC_GetInputVoltageForDisplay();
    float output = BuckADC_GetOutputVoltageForDisplay();
    uint32_t input_estimate = (adc_input_error_code & BUCK_ADC_ERR_REFERENCE) != 0U;
    uint32_t output_estimate = (adc_output_error_code & BUCK_ADC_ERR_REFERENCE) != 0U;
    uint32_t input_source = input_estimate | ((adc_input_error_code & BUCK_ADC_ERR_NEGATIVE) ? 2U : 0U);
    uint32_t output_source = output_estimate | ((adc_output_error_code & BUCK_ADC_ERR_NEGATIVE) ? 2U : 0U);
    float input_current = BuckDisplayFilter_Get(&input_current_display_filter, HAL_GetTick());
    float output_current = BuckDisplayFilter_Get(&output_current_display_filter, HAL_GetTick());
    uint32_t current_estimate = (adc_error_code & BUCK_ADC_ERR_REFERENCE) != 0U;
    if (!isfinite(input)) BuckDisplayFilter_Reset(&input_display_filter);
    if (!isfinite(output)) BuckDisplayFilter_Reset(&output_display_filter);
    uint32_t now = HAL_GetTick();
    input = BuckDisplayFilter_Get(&input_display_filter, now);
    output = BuckDisplayFilter_Get(&output_display_filter, now);
    input = BuckDisplayDigits_Update(&input_display_digits, input, now, input_source);
    output = BuckDisplayDigits_Update(&output_display_digits, output, now, output_source);
    buck_input_voltage_display = input;
    buck_output_voltage_display = output;
    App_SetMeasurementLine(0U, "输入电压", input, "V", input_estimate);
    App_SetMeasurementLine(1U, "输入电流", input_current, "A", current_estimate);
    OLED_SetTextLine(2U, "");
    App_SetMeasurementLine(3U, "输出电压", output, "V", output_estimate);
    App_SetMeasurementLine(4U, "输出电流", output_current, "A", current_estimate);

    /* A valid ADC conversion at a rail is an input-range diagnostic, not
     * a conversion failure. Keep the module flags/validity unchanged. */
    uint32_t conversion_faults = adc_error_code
        & ~(BUCK_ADC_ERR_REFERENCE | BUCK_ADC_ERR_NEGATIVE | BUCK_ADC_ERR_RAIL);
    uint32_t input_limit = adc_input_error_code & BUCK_ADC_ERR_RAIL;
    uint32_t output_limit = adc_output_error_code & BUCK_ADC_ERR_RAIL;
    const char *signal_state = NULL;
    if (conversion_faults != 0U)
        signal_state = "ADC ERROR";
    else if (input_limit != 0U && output_limit != 0U)
        signal_state = "VIN VOUT ADC LIMIT";
    else if (input_limit != 0U)
        signal_state = "VIN ADC LIMIT";
    else if (output_limit != 0U)
        signal_state = "VOUT ADC LIMIT";
    else if ((adc_error_code & BUCK_ADC_ERR_NEGATIVE) != 0U)
        signal_state = "NEGATIVE DIFF";
    else if ((adc_input_current_error_code | adc_output_current_error_code) != 0U)
        signal_state = "CURRENT ADC ERROR";

    const char *state = "ADC OK";
    if ((adc_error_code & BUCK_ADC_ERR_VREFBUF_READY) != 0U)
        state = "VREF NOT READY";
    else if ((adc_error_code & BUCK_ADC_ERR_REFERENCE_MODE) != 0U)
        state = "VREF CONFIG ERROR";
    else if (signal_state != NULL)
        state = signal_state;
    else if (BUCK_ADC_INTERNAL_REFERENCE_TEST && (adc_input_estimate_valid || adc_output_estimate_valid)
             && (adc_error_code & BUCK_ADC_ERR_REFERENCE) != 0U)
        state = "NOMINAL VREF 2.5V";
    else if ((adc_error_code & BUCK_ADC_ERR_REFERENCE) != 0U)
        state = "REF UNCONFIRMED";
    OLED_SetTextLine(2U, "");
    OLED_SetTextLine(5U, state);
    /* Keep acquisition visible; the half-input controller also shows its
     * current, unsmoothed final target once valid feedback has been used. */
#if ADC_ONLY_TEST
    uint32_t full0 = adc_input_full_total[0];
    uint32_t full1 = adc_input_full_total[1];
    uint32_t zero0 = adc_input_zero_total[0];
    uint32_t zero1 = adc_input_zero_total[1];
    snprintf(line, sizeof(line), "A0 F/Z:%02lu/%02lu A1:%02lu/%02lu",
             (unsigned long)(full0 > 99U ? 99U : full0),
             (unsigned long)(zero0 > 99U ? 99U : zero0),
             (unsigned long)(full1 > 99U ? 99U : full1),
             (unsigned long)(zero1 > 99U ? 99U : zero1));
#else
    if (buck_control_state == BUCK_CONTROL_FAULT || buck_control_async_fault != 0U)
        snprintf(line, sizeof(line), "PID ERR:%04lX",
                 (unsigned long)(buck_control_fault | buck_control_async_fault));
    else
        snprintf(line, sizeof(line), "EI:%04lX EO:%04lX",
                 (unsigned long)adc_input_error_code, (unsigned long)adc_output_error_code);
#endif
    OLED_SetTextLine(6U, line);
#if !ADC_ONLY_TEST
    if ((buck_control_state == BUCK_CONTROL_SOFT_START
         || buck_control_state == BUCK_CONTROL_RUNNING
         || buck_control_state == BUCK_CONTROL_PREVIEW)
        && isfinite(buck_control_target) && buck_control_target > 0.0f
        && buck_control_async_fault == 0U)
        App_SetVoltageLine(6U, "SET", buck_control_target, input_estimate);
    if (adc_first_input_rail.valid && buck_control_state != BUCK_CONTROL_FAULT)
    {
        if ((adc_first_input_rail.endpoint_mask & 0x03U) != 0U)
            snprintf(line, sizeof(line), "A0 R2:%4lu R4:%4lu",
                     (unsigned long)adc_first_input_rail.rank_raw[1],
                     (unsigned long)adc_first_input_rail.input_plus_confirm);
        else
            snprintf(line, sizeof(line), "A1 R6:%4lu R7:%4lu",
                     (unsigned long)adc_first_input_rail.rank_raw[5],
                     (unsigned long)adc_first_input_rail.rank_raw[6]);
        OLED_SetTextLine(6U, line);
    }
#endif
#if ADC_ONLY_TEST || BUCK_CONTROL_POWER_STAGE
    OLED_SetTextLine(7U, BuckControl_StateText());
#else
    OLED_SetTextLine(7U, "OPEN LOOP PWM");
#endif
    if (buck_control_state == BUCK_CONTROL_FAULT && buck_control_fault_snapshot.valid)
    {
        /* Freeze first-fault evidence. Live ADC after stopping must not
         * replace the error/unsmoothed voltage that actually stopped PWM. */
        const volatile BuckControlFaultSnapshot *fault = &buck_control_fault_snapshot;
        buck_input_voltage_display = fault->input_voltage;
        buck_output_voltage_display = fault->output_voltage;
        App_SetVoltageLine(0U, "F VIN", fault->input_voltage,
                           (fault->input_error & BUCK_ADC_ERR_REFERENCE) != 0U);
        App_SetVoltageLine(1U, "F VOUT", fault->output_voltage,
                           (fault->output_error & BUCK_ADC_ERR_REFERENCE) != 0U);
        /* Show controller rejection separately from raw ADC diagnostics.
         * Elapsed time/start count remain in the debugger fault snapshot. */
        snprintf(line, sizeof(line), "AGE%lu FB%02lX E%04lX",
                 (unsigned long)fault->sample_age_ms,
                 (unsigned long)(fault->feedback_error & 0x0FU),
                 (unsigned long)fault->control_error);
        OLED_SetTextLine(2U, line);
        if (adc_first_input_rail.valid)
        {
            if ((adc_first_input_rail.endpoint_mask & 0x03U) != 0U)
            {
                snprintf(line, sizeof(line), "A0 R1:%4lu R2:%4lu",
                         (unsigned long)adc_first_input_rail.rank_raw[0],
                         (unsigned long)adc_first_input_rail.rank_raw[1]);
                OLED_SetTextLine(3U, line);
                snprintf(line, sizeof(line), "R3:%4lu R4:%4lu N:%02lu",
                         (unsigned long)adc_first_input_rail.rank_raw[2],
                         (unsigned long)adc_first_input_rail.input_plus_confirm,
                         (unsigned long)adc_first_input_rail.frame_number);
                OLED_SetTextLine(4U, line);
            }
            else
            {
                snprintf(line, sizeof(line), "A1 R6:%4lu R7:%4lu",
                         (unsigned long)adc_first_input_rail.rank_raw[5],
                         (unsigned long)adc_first_input_rail.rank_raw[6]);
                OLED_SetTextLine(3U, line);
                snprintf(line, sizeof(line), "A0 R4:%4lu R5:%4lu",
                         (unsigned long)adc_first_input_rail.rank_raw[3],
                         (unsigned long)adc_first_input_rail.rank_raw[4]);
                OLED_SetTextLine(4U, line);
            }
        }
        else if (fault->raw_valid)
        {
            snprintf(line, sizeof(line), "F IN +%4lu -%4lu",
                     (unsigned long)fault->input_raw_plus, (unsigned long)fault->input_raw_minus);
            OLED_SetTextLine(3U, line);
            snprintf(line, sizeof(line), "F OUT+%4lu -%4lu",
                     (unsigned long)fault->output_raw_plus, (unsigned long)fault->output_raw_minus);
            OLED_SetTextLine(4U, line);
        }
        else
        {
            OLED_SetTextLine(3U, "F RAW INVALID");
            OLED_SetTextLine(4U, "SEE FI/FO ERROR");
        }
        snprintf(line, sizeof(line), "FI:%04lX FO:%04lX",
                 (unsigned long)fault->input_error, (unsigned long)fault->output_error);
        OLED_SetTextLine(5U, line);
        uint32_t full0 = fault->input_full_total[0];
        uint32_t full1 = fault->input_full_total[1];
        uint32_t zero0 = fault->input_zero_total[0];
        uint32_t zero1 = fault->input_zero_total[1];
        snprintf(line, sizeof(line), "A0 F/Z:%02lu/%02lu A1:%02lu/%02lu",
                 (unsigned long)(full0 > 99U ? 99U : full0),
                 (unsigned long)(zero0 > 99U ? 99U : zero0),
                 (unsigned long)(full1 > 99U ? 99U : full1),
                 (unsigned long)(zero1 > 99U ? 99U : zero1));
        OLED_SetTextLine(6U, line);
    }
}
/* USER CODE END 0 */

int main(void)
{

  /* MCU Configuration--------------------------------------------------------*/

  /* Reset of all peripherals, Initializes the Flash interface and the Systick. */
  HAL_Init();

  /* USER CODE BEGIN Init */
#if ADC_ONLY_TEST || BUCK_CONTROL_POWER_STAGE
  App_HoldPWMInactive();
#endif
  /* USER CODE END Init */

  /* Configure the system clock */
  SystemClock_Config();

  /* USER CODE BEGIN SysInit */
  /* An HSE clock failure enters NMI_Handler(), which stops the PWM outputs. */
  HAL_RCC_EnableCSS();
  /* USER CODE END SysInit */

  /* Initialize all configured peripherals */
  MX_GPIO_Init();
  /* USER CODE BEGIN 2 */
#if !ADC_ONLY_TEST
  BuckPWM_Init();
#endif
  OLED_Init();
  adc_init_status = BuckADC_Init();
  if (adc_init_status == HAL_OK) (void)BuckADC_ReadVoltage();
  BuckControl_Init();
  App_UpdateVoltageMonitor();
  App_UpdateVoltageDisplay();
#if !ADC_ONLY_TEST && !BUCK_CONTROL_POWER_STAGE
  /* Only compiled after explicitly selecting ADC_ONLY_TEST=OFF. */
  BuckPWM_Start();
#endif
  uint32_t sample_tick = HAL_GetTick();
  uint32_t display_tick = sample_tick;
  /* USER CODE END 2 */

  /* Infinite loop */
  while (1)
  {

    /* USER CODE BEGIN 3 */
    uint32_t now = HAL_GetTick();
    uint32_t elapsed = now - sample_tick;
    if (elapsed >= BUCK_ADC_UPDATE_MS)
    {
      /* Skip expired slots rather than burst-sampling to catch up. */
      uint32_t periods = elapsed / BUCK_ADC_UPDATE_MS;
      adc_schedule_missed += periods - 1U;
      sample_tick += periods * BUCK_ADC_UPDATE_MS;
      if (adc_init_status == HAL_OK) (void)BuckADC_ReadVoltage();
      BuckControl_Process(HAL_GetTick());
      App_UpdateVoltageMonitor();
    }
    now = HAL_GetTick();
    /* STOP/START requests are serviced without waiting for OLED refresh. */
    BuckControl_Process(now);
    if ((uint32_t)(now - display_tick) >= 200U)
    {
      display_tick = now;
      App_UpdateVoltageDisplay();
    }
    /* Software SPI runs only with at least 3 ms until the next sample slot.
     * Check adc_schedule_missed on hardware; this is cooperative monitoring,
     * not a PWM-synchronous control-loop sampling schedule. */
    if ((uint32_t)(HAL_GetTick() - sample_tick) < BUCK_ADC_UPDATE_MS - 3U)
      OLED_Process();
  }
  /* USER CODE END 3 */
}

void SystemClock_Config(void)
{
  RCC_OscInitTypeDef RCC_OscInitStruct = {0};
  RCC_ClkInitTypeDef RCC_ClkInitStruct = {0};

  /** Configure the main internal regulator output voltage
  */
  if (HAL_PWREx_ControlVoltageScaling(PWR_REGULATOR_VOLTAGE_SCALE1_BOOST) != HAL_OK)
  {
    Error_Handler();
  }

  /** Initializes the RCC Oscillators according to the specified parameters
  * in the RCC_OscInitTypeDef structure.
  */
  /* Board crystal: 8 MHz, crystal/resonator mode (not external-clock bypass). */

  RCC_OscInitStruct.OscillatorType = RCC_OSCILLATORTYPE_HSE;
  RCC_OscInitStruct.HSEState = RCC_HSE_ON;
  /* 8 MHz / 2 * 84 / 2 = 168 MHz SYSCLK and TIM1 clock. */
  RCC_OscInitStruct.PLL.PLLState = RCC_PLL_ON;
  RCC_OscInitStruct.PLL.PLLSource = RCC_PLLSOURCE_HSE;
  RCC_OscInitStruct.PLL.PLLM = RCC_PLLM_DIV2;
  RCC_OscInitStruct.PLL.PLLN = 84;
  RCC_OscInitStruct.PLL.PLLP = RCC_PLLP_DIV2;
  RCC_OscInitStruct.PLL.PLLQ = RCC_PLLQ_DIV2;
  RCC_OscInitStruct.PLL.PLLR = RCC_PLLR_DIV2;
  if (HAL_RCC_OscConfig(&RCC_OscInitStruct) != HAL_OK)
  {
    Error_Handler();
  }

  /** Initializes the CPU, AHB and APB buses clocks
  */
  RCC_ClkInitStruct.ClockType = RCC_CLOCKTYPE_HCLK|RCC_CLOCKTYPE_SYSCLK
                              |RCC_CLOCKTYPE_PCLK1|RCC_CLOCKTYPE_PCLK2;
  RCC_ClkInitStruct.SYSCLKSource = RCC_SYSCLKSOURCE_PLLCLK;
  RCC_ClkInitStruct.AHBCLKDivider = RCC_SYSCLK_DIV1;
  RCC_ClkInitStruct.APB1CLKDivider = RCC_HCLK_DIV1;
  RCC_ClkInitStruct.APB2CLKDivider = RCC_HCLK_DIV1;

  if (HAL_RCC_ClockConfig(&RCC_ClkInitStruct, FLASH_LATENCY_4) != HAL_OK)
  {
    Error_Handler();
  }
}

static void MX_GPIO_Init(void)
{
  GPIO_InitTypeDef GPIO_InitStruct = {0};

  /* GPIO Ports Clock Enable */
  __HAL_RCC_GPIOA_CLK_ENABLE();

  /*Configure GPIO pin Output Level */
  HAL_GPIO_WritePin(LED_GPIO_Port, LED_Pin, GPIO_PIN_RESET);

  /*Configure GPIO pin : LED_Pin */
  GPIO_InitStruct.Pin = LED_Pin;
  GPIO_InitStruct.Mode = GPIO_MODE_OUTPUT_PP;
  GPIO_InitStruct.Pull = GPIO_NOPULL;
  GPIO_InitStruct.Speed = GPIO_SPEED_FREQ_LOW;
  HAL_GPIO_Init(LED_GPIO_Port, &GPIO_InitStruct);

}

void Error_Handler(void)
{
  /* USER CODE BEGIN Error_Handler_Debug */
  BuckPWM_Stop();
  /* User can add his own implementation to report the HAL error return state */
  __disable_irq();
  while (1)
  {
  }
  /* USER CODE END Error_Handler_Debug */
}
